## config/boards/shields/cleave_hhjp/Kconfig.defconfig
```kconfig
# Copyright (c) 2025
# SPDX-License-Identifier: MIT

if SHIELD_CLEAVE_HHJP_LEFT

config ZMK_KEYBOARD_NAME
	default "CLEAVE HHJP"

config ZMK_SPLIT_ROLE_CENTRAL
	default y

config ZMK_SPLIT_BLE_CENTRAL_PERIPHERALS
	default 1

config BT_MAX_CONN
	default 5

endif

if SHIELD_CLEAVE_HHJP_LEFT || SHIELD_CLEAVE_HHJP_RIGHT

config ZMK_SPLIT
	default y

endif
```

## firmware/config/boards/shields/cleave_hhjp/Kconfig.shield
```kconfig
# Copyright (c) 2025
# SPDX-License-Identifier: MIT

config SHIELD_CLEAVE_HHJP_LEFT
	def_bool $(shields_list_contains,cleave_hhjp_left)

config SHIELD_CLEAVE_HHJP_RIGHT
	def_bool $(shields_list_contains,cleave_hhjp_right)
```
